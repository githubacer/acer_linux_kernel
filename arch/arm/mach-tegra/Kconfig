## arch/arm/mach-tegra/Kconfig
```kconfig
if ARCH_TEGRA

comment "NVIDIA Tegra options"

choice
	prompt "Select Tegra processor family for target system"

config ARCH_TEGRA_2x_SOC
	bool "Tegra 2 family"
	select CPU_V7
	select ARM_GIC
	help
	  Support for NVIDIA Tegra AP20 and T20 processors, based on the
	  ARM CortexA9MP CPU and the ARM PL310 L2 cache controller

endchoice


choice
	prompt "Select Tegra-based product"

config MACH_HARMONY
       bool "Harmony board"
       help
         Support for nVidia Harmony development platform

endchoice

endif
```
